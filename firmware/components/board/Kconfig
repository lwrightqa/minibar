## firmware/components/board/Kconfig
```kconfig
menu "TinyBar board (Waveshare ESP32-S3-Touch-LCD-3.49 V2)"

    choice TINYBAR_IMU_UP
        prompt "IMU axis that points up when the bar stands upright (side buttons on top)"
        default TINYBAR_IMU_UP_Y_NEG
        help
            The bar stands on a long edge, so gravity runs along the panel's short side: one of the QMI8658's X or Y
            axes, depending on how the chip sits on the board. Upright is the way the user stands the bar, with the
            side buttons (BOOT, PWR) on top (verified on the V2 board, 2026-10-05); there the Y axis reads about
            -1000 mg, so the default is -Y. Pick the axis that reads about +1000 mg standing upright: the boot log
            prints the reading ("IMU at start: x=... y=... z=... mg"); see components/board/README.md, step 5.
            Upright is what the bar starts with when the IMU can't tell (lying flat) and nothing is remembered.
            This and TINYBAR_LCD_TURN_180 go together: inverting both leaves every steady picture as it was and only
            changes which pose counts as upright. If the picture is upside down both ways up once the bar has stood
            still for half a second, change TINYBAR_LCD_TURN_180, not this.

        config TINYBAR_IMU_UP_X_POS
            bool "+X"
        config TINYBAR_IMU_UP_X_NEG
            bool "-X"
        config TINYBAR_IMU_UP_Y_POS
            bool "+Y"
        config TINYBAR_IMU_UP_Y_NEG
            bool "-Y"
    endchoice

    config TINYBAR_BL_ZERO_DUTY
        int "LCD_BL duty (of 255) at which the backlight goes dark"
        range 64 255
        default 164
        help
            GPIO 42 dims the AP3032 backlight driver through its feedback pin: the longer the pin is high, the
            dimmer, and from the V2 schematic the light goes out at about 64% high (164 of 255). Brightness levels
            are spread over 0..this duty. Measure it at bring-up (README) and set it here.

    config TINYBAR_AUDIO_VOLUME
        int "Speaker volume (esp_codec_dev scale: 0..100 is -50..0 dB on the ES8311 DAC)"
        range 0 100
        default 75
        help
            The chime and the ticks are synthesized at the mock-up's digital levels (chime -13 dBFS, Soft tick -31,
            Medium -23), so this one setting sets how loud the bar is. It's an open office: start low and tune it
            on the real bar.

    config TINYBAR_AUDIO_AMP_GATE
        bool "Switch the speaker amplifier off while silent"
        default y
        help
            EXIO7 (NS_MODE) is the NS4150B amplifier's CTRL pin, pulled low (off) on the board. With this on, the
            amplifier is switched on 40 ms before a sound and off 1.5 s after the last one (it stays on while focus
            ticking is on), so the speaker can't hiss in a quiet office. Off: on all the time, as Waveshare's
            examples leave it.

    config TINYBAR_BOARD_BRINGUP
        bool "Board bring-up self-test (logs, backlight sweep, sounds; never ship it)"
        default n
        help
            For the first runs on a new board (components/board/README.md): logs the devices on the I2C bus, the
            accelerometer's raw reading, a backlight duty sweep and every button and touch press, and plays the
            chime and both tick levels.

    config TINYBAR_LCD_TURN_180
        bool "Turn the picture 180 degrees (upright, buttons on top, is LVGL rotation 270)"
        default y
        help
            Waveshare's 10_LVGL_V9_Test draws with LVGL rotation 90, and the layout turns to 270 when the bar is
            flipped. On the V2 board, upright (side buttons on top, the way the user stands the bar) needs 270
            (verified 2026-10-05), so this is on: it swaps 90 and 270 everywhere. It goes with TINYBAR_IMU_UP (-Y by
            default): inverting both leaves every steady picture as it was. If the picture is upside down both ways
            up once the bar has stood still for half a second, change this; without an IMU it's the only way to turn
            the picture.

    config TINYBAR_LCD_PCLK_MHZ
        int "QSPI clock for the panel (MHz)"
        range 10 80
        default 40
        help
            40 MHz, as in Waveshare's 10_LVGL_V9_Test.

endmenu
```

## firmware/main/Kconfig.projbuild
```kconfig
menu "TinyBar"

    choice TINYBAR_API_AUTH
        prompt "API authorization (docs/api.md section 4)"
        default TINYBAR_API_AUTH_BEARER
        help
            Pairing is Proposed in api.md and waits for the user's OK. With "none", info and the mDNS TXT record say
            auth=none, tokens are ignored, and the pairing endpoints answer as api.md 4.1 describes.

        config TINYBAR_API_AUTH_BEARER
            bool "Pairing with a code, bearer tokens and scopes"
        config TINYBAR_API_AUTH_NONE
            bool "No pairing (anyone on the Wi-Fi can use the API)"
    endchoice

    config TINYBAR_RELEASE
        bool "Release build (log at Warning, so the USB port stays quiet)"
        default n

    config TINYBAR_APP_TASK_STACK
        int "App task stack (bytes)"
        default 12288
        help
            The app task runs core, the ui, LVGL rendering and the router (HTTP and USB requests through tb_bus_exec).

endmenu
```
