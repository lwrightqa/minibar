/* cal_tz_table.inc: IANA time zone name -> POSIX TZ rule. GENERATED by tools/gen_tz_table.py from
 * tzdata 2026e; do not edit by hand. 597 names, 93 distinct rules. */

#define TZ_NAME_COUNT 597
#define TZ_RULE_COUNT 93

static const char TZ_RULES[] =
    "<+00>0\0"
    "<+00>0<+02>-2,M3.5.0/1,M10.5.0/3\0"
    "<+01>-1\0"
    "<+02>-2\0"
    "<+0330>-3:30\0"
    "<+03>-3\0"
    "<+0430>-4:30\0"
    "<+04>-4\0"
    "<+0530>-5:30\0"
    "<+0545>-5:45\0"
    "<+05>-5\0"
    "<+0630>-6:30\0"
    "<+06>-6\0"
    "<+07>-7\0"
    "<+0845>-8:45\0"
    "<+08>-8\0"
    "<+09>-9\0"
    "<+1030>-10:30<+11>-11,M10.1.0,M4.1.0\0"
    "<+10>-10\0"
    "<+11>-11\0"
    "<+11>-11<+12>,M10.1.0,M4.1.0/3\0"
    "<+1245>-12:45<+1345>,M9.5.0/2:45,M4.1.0/3:45\0"
    "<+12>-12\0"
    "<+13>-13\0"
    "<+14>-14\0"
    "<-01>1\0"
    "<-01>1<+00>,M3.5.0/0,M10.5.0/1\0"
    "<-02>2\0"
    "<-02>2<-01>,M3.5.0/-1,M10.5.0/0\0"
    "<-03>3\0"
    "<-03>3<-02>,M3.2.0,M11.1.0\0"
    "<-04>4\0"
    "<-04>4<-03>,M9.1.6/24,M4.1.6/24\0"
    "<-05>5\0"
    "<-06>6\0"
    "<-06>6<-05>,M9.1.6/22,M4.1.6/22\0"
    "<-07>7\0"
    "<-08>8\0"
    "<-0930>9:30\0"
    "<-09>9\0"
    "<-10>10\0"
    "<-11>11\0"
    "<-12>12\0"
    "ACST-9:30\0"
    "ACST-9:30ACDT,M10.1.0,M4.1.0/3\0"
    "AEST-10\0"
    "AEST-10AEDT,M10.1.0,M4.1.0/3\0"
    "AKST9AKDT,M3.2.0,M11.1.0\0"
    "AST4\0"
    "AST4ADT,M3.2.0,M11.1.0\0"
    "AWST-8\0"
    "CAT-2\0"
    "CET-1\0"
    "CET-1CEST,M3.5.0,M10.5.0/3\0"
    "CST-8\0"
    "CST5CDT,M3.2.0/0,M11.1.0/1\0"
    "CST6\0"
    "CST6CDT,M3.2.0,M11.1.0\0"
    "ChST-10\0"
    "EAT-3\0"
    "EET-2\0"
    "EET-2EEST,M3.4.4/50,M10.4.4/50\0"
    "EET-2EEST,M3.5.0/0,M10.5.0/0\0"
    "EET-2EEST,M3.5.0/3,M10.5.0/4\0"
    "EET-2EEST,M4.5.5/0,M10.5.4/24\0"
    "EST5\0"
    "EST5EDT,M3.2.0,M11.1.0\0"
    "GMT0\0"
    "GMT0BST,M3.5.0/1,M10.5.0\0"
    "HKT-8\0"
    "HST10\0"
    "HST10HDT,M3.2.0,M11.1.0\0"
    "IST-1GMT0,M10.5.0,M3.5.0/1\0"
    "IST-2IDT,M3.4.4/26,M10.5.0\0"
    "IST-5:30\0"
    "JST-9\0"
    "KST-9\0"
    "MSK-3\0"
    "MST7\0"
    "MST7MDT,M3.2.0,M11.1.0\0"
    "NST3:30NDT,M3.2.0,M11.1.0\0"
    "NZST-12NZDT,M9.5.0,M4.1.0/3\0"
    "PKT-5\0"
    "PST-8\0"
    "PST8PDT,M3.2.0,M11.1.0\0"
    "SAST-2\0"
    "SST11\0"
    "UTC0\0"
    "WAT-1\0"
    "WET0WEST,M3.5.0/1,M10.5.0\0"
    "WIB-7\0"
    "WIT-9\0"
    "WITA-8\0";

static const uint16_t TZ_RULE_OFF[TZ_RULE_COUNT] = {
    0, 7, 40, 48, 56, 69, 77, 90, 98, 111, 124, 132,
    145, 153, 161, 174, 182, 190, 227, 236, 245, 276, 321, 330,
    339, 348, 355, 386, 393, 425, 432, 459, 466, 498, 505, 512,
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    1247, 1270, 1277, 1283, 1288, 1294, 1320, 1326, 1332,
};

static const char TZ_NAMES[] =
    "Africa/Abidjan\0"
    "Africa/Accra\0"
    "Africa/Addis_Ababa\0"
    "Africa/Algiers\0"
    "Africa/Asmara\0"
    "Africa/Asmera\0"
    "Africa/Bamako\0"
    "Africa/Bangui\0"
    "Africa/Banjul\0"
    "Africa/Bissau\0"
    "Africa/Blantyre\0"
    "Africa/Brazzaville\0"
    "Africa/Bujumbura\0"
    "Africa/Cairo\0"
    "Africa/Casablanca\0"
    "Africa/Ceuta\0"
    "Africa/Conakry\0"
    "Africa/Dakar\0"
    "Africa/Dar_es_Salaam\0"
    "Africa/Djibouti\0"
    "Africa/Douala\0"
    "Africa/El_Aaiun\0"
    "Africa/Freetown\0"
    "Africa/Gaborone\0"
    "Africa/Harare\0"
    "Africa/Johannesburg\0"
    "Africa/Juba\0"
    "Africa/Kampala\0"
    "Africa/Khartoum\0"
    "Africa/Kigali\0"
    "Africa/Kinshasa\0"
    "Africa/Lagos\0"
    "Africa/Libreville\0"
    "Africa/Lome\0"
    "Africa/Luanda\0"
    "Africa/Lubumbashi\0"
    "Africa/Lusaka\0"
    "Africa/Malabo\0"
    "Africa/Maputo\0"
    "Africa/Maseru\0"
    "Africa/Mbabane\0"
    "Africa/Mogadishu\0"
    "Africa/Monrovia\0"
    "Africa/Nairobi\0"
    "Africa/Ndjamena\0"
    "Africa/Niamey\0"
    "Africa/Nouakchott\0"
    "Africa/Ouagadougou\0"
    "Africa/Porto-Novo\0"
    "Africa/Sao_Tome\0"
    "Africa/Timbuktu\0"
    "Africa/Tripoli\0"
    "Africa/Tunis\0"
    "Africa/Windhoek\0"
    "America/Adak\0"
    "America/Anchorage\0"
    "America/Anguilla\0"
    "America/Antigua\0"
    "America/Araguaina\0"
    "America/Argentina/Buenos_Aires\0"
    "America/Argentina/Catamarca\0"
    "America/Argentina/ComodRivadavia\0"
    "America/Argentina/Cordoba\0"
    "America/Argentina/Jujuy\0"
    "America/Argentina/La_Rioja\0"
    "America/Argentina/Mendoza\0"
    "America/Argentina/Rio_Gallegos\0"
    "America/Argentina/Salta\0"
    "America/Argentina/San_Juan\0"
    "America/Argentina/San_Luis\0"
    "America/Argentina/Tucuman\0"
    "America/Argentina/Ushuaia\0"
    "America/Aruba\0"
    "America/Asuncion\0"
    "America/Atikokan\0"
    "America/Atka\0"
    "America/Bahia\0"
    "America/Bahia_Banderas\0"
    "America/Barbados\0"
    "America/Belem\0"
    "America/Belize\0"
    "America/Blanc-Sablon\0"
    "America/Boa_Vista\0"
    "America/Bogota\0"
    "America/Boise\0"
    "America/Buenos_Aires\0"
    "America/Cambridge_Bay\0"
    "America/Campo_Grande\0"
    "America/Cancun\0"
    "America/Caracas\0"
    "America/Catamarca\0"
    "America/Cayenne\0"
    "America/Cayman\0"
    "America/Chicago\0"
    "America/Chihuahua\0"
    "America/Ciudad_Juarez\0"
    "America/Coral_Harbour\0"
    "America/Cordoba\0"
    "America/Costa_Rica\0"
    "America/Coyhaique\0"
    "America/Creston\0"
    "America/Cuiaba\0"
    "America/Curacao\0"
    "America/Danmarkshavn\0"
    "America/Dawson\0"
    "America/Dawson_Creek\0"
    "America/Denver\0"
    "America/Detroit\0"
    "America/Dominica\0"
    "America/Edmonton\0"
    "America/Eirunepe\0"
    "America/El_Salvador\0"
    "America/Ensenada\0"
    "America/Fort_Nelson\0"
    "America/Fort_Wayne\0"
    "America/Fortaleza\0"
    "America/Glace_Bay\0"
    "America/Godthab\0"
    "America/Goose_Bay\0"
    "America/Grand_Turk\0"
    "America/Grenada\0"
    "America/Guadeloupe\0"
    "America/Guatemala\0"
    "America/Guayaquil\0"
    "America/Guyana\0"
    "America/Halifax\0"
    "America/Havana\0"
    "America/Hermosillo\0"
    "America/Indiana/Indianapolis\0"
    "America/Indiana/Knox\0"
    "America/Indiana/Marengo\0"
    "America/Indiana/Petersburg\0"
    "America/Indiana/Tell_City\0"
    "America/Indiana/Vevay\0"
    "America/Indiana/Vincennes\0"
    "America/Indiana/Winamac\0"
    "America/Indianapolis\0"
    "America/Inuvik\0"
    "America/Iqaluit\0"
    "America/Jamaica\0"
    "America/Jujuy\0"
    "America/Juneau\0"
    "America/Kentucky/Louisville\0"
    "America/Kentucky/Monticello\0"
    "America/Knox_IN\0"
    "America/Kralendijk\0"
    "America/La_Paz\0"
    "America/Lima\0"
    "America/Los_Angeles\0"
    "America/Louisville\0"
    "America/Lower_Princes\0"
    "America/Maceio\0"
    "America/Managua\0"
    "America/Manaus\0"
    "America/Marigot\0"
    "America/Martinique\0"
    "America/Matamoros\0"
    "America/Mazatlan\0"
    "America/Mendoza\0"
    "America/Menominee\0"
    "America/Merida\0"
    "America/Metlakatla\0"
    "America/Mexico_City\0"
    "America/Miquelon\0"
    "America/Moncton\0"
    "America/Monterrey\0"
    "America/Montevideo\0"
    "America/Montreal\0"
    "America/Montserrat\0"
    "America/Nassau\0"
    "America/New_York\0"
    "America/Nipigon\0"
    "America/Nome\0"
    "America/Noronha\0"
    "America/North_Dakota/Beulah\0"
    "America/North_Dakota/Center\0"
    "America/North_Dakota/New_Salem\0"
    "America/Nuuk\0"
    "America/Ojinaga\0"
    "America/Panama\0"
    "America/Pangnirtung\0"
    "America/Paramaribo\0"
    "America/Phoenix\0"
    "America/Port-au-Prince\0"
    "America/Port_of_Spain\0"
    "America/Porto_Acre\0"
    "America/Porto_Velho\0"
    "America/Puerto_Rico\0"
    "America/Punta_Arenas\0"
    "America/Rainy_River\0"
    "America/Rankin_Inlet\0"
    "America/Recife\0"
    "America/Regina\0"
    "America/Resolute\0"
    "America/Rio_Branco\0"
    "America/Rosario\0"
    "America/Santa_Isabel\0"
    "America/Santarem\0"
    "America/Santiago\0"
    "America/Santo_Domingo\0"
    "America/Sao_Paulo\0"
    "America/Scoresbysund\0"
    "America/Shiprock\0"
    "America/Sitka\0"
    "America/St_Barthelemy\0"
    "America/St_Johns\0"
    "America/St_Kitts\0"
    "America/St_Lucia\0"
    "America/St_Thomas\0"
    "America/St_Vincent\0"
    "America/Swift_Current\0"
    "America/Tegucigalpa\0"
    "America/Thule\0"
    "America/Thunder_Bay\0"
    "America/Tijuana\0"
    "America/Toronto\0"
    "America/Tortola\0"
    "America/Vancouver\0"
    "America/Virgin\0"
    "America/Whitehorse\0"
    "America/Winnipeg\0"
    "America/Yakutat\0"
    "America/Yellowknife\0"
    "Antarctica/Casey\0"
    "Antarctica/Davis\0"
    "Antarctica/DumontDUrville\0"
    "Antarctica/Macquarie\0"
    "Antarctica/Mawson\0"
    "Antarctica/McMurdo\0"
    "Antarctica/Palmer\0"
    "Antarctica/Rothera\0"
    "Antarctica/South_Pole\0"
    "Antarctica/Syowa\0"
    "Antarctica/Troll\0"
    "Antarctica/Vostok\0"
    "Arctic/Longyearbyen\0"
    "Asia/Aden\0"
    "Asia/Almaty\0"
    "Asia/Amman\0"
    "Asia/Anadyr\0"
    "Asia/Aqtau\0"
    "Asia/Aqtobe\0"
    "Asia/Ashgabat\0"
    "Asia/Ashkhabad\0"
    "Asia/Atyrau\0"
    "Asia/Baghdad\0"
    "Asia/Bahrain\0"
    "Asia/Baku\0"
    "Asia/Bangkok\0"
    "Asia/Barnaul\0"
    "Asia/Beirut\0"
    "Asia/Bishkek\0"
    "Asia/Brunei\0"
    "Asia/Calcutta\0"
    "Asia/Chita\0"
    "Asia/Choibalsan\0"
    "Asia/Chongqing\0"
    "Asia/Chungking\0"
    "Asia/Colombo\0"
    "Asia/Dacca\0"
    "Asia/Damascus\0"
    "Asia/Dhaka\0"
    "Asia/Dili\0"
    "Asia/Dubai\0"
    "Asia/Dushanbe\0"
    "Asia/Famagusta\0"
    "Asia/Gaza\0"
    "Asia/Harbin\0"
    "Asia/Hebron\0"
    "Asia/Ho_Chi_Minh\0"
    "Asia/Hong_Kong\0"
    "Asia/Hovd\0"
    "Asia/Irkutsk\0"
    "Asia/Istanbul\0"
    "Asia/Jakarta\0"
    "Asia/Jayapura\0"
    "Asia/Jerusalem\0"
    "Asia/Kabul\0"
    "Asia/Kamchatka\0"
    "Asia/Karachi\0"
    "Asia/Kashgar\0"
    "Asia/Kathmandu\0"
    "Asia/Katmandu\0"
    "Asia/Khandyga\0"
    "Asia/Kolkata\0"
    "Asia/Krasnoyarsk\0"
    "Asia/Kuala_Lumpur\0"
    "Asia/Kuching\0"
    "Asia/Kuwait\0"
    "Asia/Macao\0"
    "Asia/Macau\0"
    "Asia/Magadan\0"
    "Asia/Makassar\0"
    "Asia/Manila\0"
    "Asia/Muscat\0"
    "Asia/Nicosia\0"
    "Asia/Novokuznetsk\0"
    "Asia/Novosibirsk\0"
    "Asia/Omsk\0"
    "Asia/Oral\0"
    "Asia/Phnom_Penh\0"
    "Asia/Pontianak\0"
    "Asia/Pyongyang\0"
    "Asia/Qatar\0"
    "Asia/Qostanay\0"
    "Asia/Qyzylorda\0"
    "Asia/Rangoon\0"
    "Asia/Riyadh\0"
    "Asia/Saigon\0"
    "Asia/Sakhalin\0"
    "Asia/Samarkand\0"
    "Asia/Seoul\0"
    "Asia/Shanghai\0"
    "Asia/Singapore\0"
    "Asia/Srednekolymsk\0"
    "Asia/Taipei\0"
    "Asia/Tashkent\0"
    "Asia/Tbilisi\0"
    "Asia/Tehran\0"
    "Asia/Tel_Aviv\0"
    "Asia/Thimbu\0"
    "Asia/Thimphu\0"
    "Asia/Tokyo\0"
    "Asia/Tomsk\0"
    "Asia/Ujung_Pandang\0"
    "Asia/Ulaanbaatar\0"
    "Asia/Ulan_Bator\0"
    "Asia/Urumqi\0"
    "Asia/Ust-Nera\0"
    "Asia/Vientiane\0"
    "Asia/Vladivostok\0"
    "Asia/Yakutsk\0"
    "Asia/Yangon\0"
    "Asia/Yekaterinburg\0"
    "Asia/Yerevan\0"
    "Atlantic/Azores\0"
    "Atlantic/Bermuda\0"
    "Atlantic/Canary\0"
    "Atlantic/Cape_Verde\0"
    "Atlantic/Faeroe\0"
    "Atlantic/Faroe\0"
    "Atlantic/Jan_Mayen\0"
    "Atlantic/Madeira\0"
    "Atlantic/Reykjavik\0"
    "Atlantic/South_Georgia\0"
    "Atlantic/St_Helena\0"
    "Atlantic/Stanley\0"
    "Australia/ACT\0"
    "Australia/Adelaide\0"
    "Australia/Brisbane\0"
    "Australia/Broken_Hill\0"
    "Australia/Canberra\0"
    "Australia/Currie\0"
    "Australia/Darwin\0"
    "Australia/Eucla\0"
    "Australia/Hobart\0"
    "Australia/LHI\0"
    "Australia/Lindeman\0"
    "Australia/Lord_Howe\0"
    "Australia/Melbourne\0"
    "Australia/NSW\0"
    "Australia/North\0"
    "Australia/Perth\0"
    "Australia/Queensland\0"
    "Australia/South\0"
    "Australia/Sydney\0"
    "Australia/Tasmania\0"
    "Australia/Victoria\0"
    "Australia/West\0"
    "Australia/Yancowinna\0"
    "Brazil/Acre\0"
    "Brazil/DeNoronha\0"
    "Brazil/East\0"
    "Brazil/West\0"
    "CET\0"
    "CST6CDT\0"
    "Canada/Atlantic\0"
    "Canada/Central\0"
    "Canada/Eastern\0"
    "Canada/Mountain\0"
    "Canada/Newfoundland\0"
    "Canada/Pacific\0"
    "Canada/Saskatchewan\0"
    "Canada/Yukon\0"
    "Chile/Continental\0"
    "Chile/EasterIsland\0"
    "Cuba\0"
    "EET\0"
    "EST\0"
    "EST5EDT\0"
    "Egypt\0"
    "Eire\0"
    "Etc/GMT\0"
    "Etc/GMT+0\0"
    "Etc/GMT+1\0"
    "Etc/GMT+10\0"
    "Etc/GMT+11\0"
    "Etc/GMT+12\0"
    "Etc/GMT+2\0"
    "Etc/GMT+3\0"
    "Etc/GMT+4\0"
    "Etc/GMT+5\0"
    "Etc/GMT+6\0"
    "Etc/GMT+7\0"
    "Etc/GMT+8\0"
    "Etc/GMT+9\0"
    "Etc/GMT-0\0"
    "Etc/GMT-1\0"
    "Etc/GMT-10\0"
    "Etc/GMT-11\0"
    "Etc/GMT-12\0"
    "Etc/GMT-13\0"
    "Etc/GMT-14\0"
    "Etc/GMT-2\0"
    "Etc/GMT-3\0"
    "Etc/GMT-4\0"
    "Etc/GMT-5\0"
    "Etc/GMT-6\0"
    "Etc/GMT-7\0"
    "Etc/GMT-8\0"
    "Etc/GMT-9\0"
    "Etc/GMT0\0"
    "Etc/Greenwich\0"
    "Etc/UCT\0"
    "Etc/UTC\0"
    "Etc/Universal\0"
    "Etc/Zulu\0"
    "Europe/Amsterdam\0"
    "Europe/Andorra\0"
    "Europe/Astrakhan\0"
    "Europe/Athens\0"
    "Europe/Belfast\0"
    "Europe/Belgrade\0"
    "Europe/Berlin\0"
    "Europe/Bratislava\0"
    "Europe/Brussels\0"
    "Europe/Bucharest\0"
    "Europe/Budapest\0"
    "Europe/Busingen\0"
    "Europe/Chisinau\0"
    "Europe/Copenhagen\0"
    "Europe/Dublin\0"
    "Europe/Gibraltar\0"
    "Europe/Guernsey\0"
    "Europe/Helsinki\0"
    "Europe/Isle_of_Man\0"
    "Europe/Istanbul\0"
    "Europe/Jersey\0"
    "Europe/Kaliningrad\0"
    "Europe/Kiev\0"
    "Europe/Kirov\0"
    "Europe/Kyiv\0"
    "Europe/Lisbon\0"
    "Europe/Ljubljana\0"
    "Europe/London\0"
    "Europe/Luxembourg\0"
    "Europe/Madrid\0"
    "Europe/Malta\0"
    "Europe/Mariehamn\0"
    "Europe/Minsk\0"
    "Europe/Monaco\0"
    "Europe/Moscow\0"
    "Europe/Nicosia\0"
    "Europe/Oslo\0"
    "Europe/Paris\0"
    "Europe/Podgorica\0"
    "Europe/Prague\0"
    "Europe/Riga\0"
    "Europe/Rome\0"
    "Europe/Samara\0"
    "Europe/San_Marino\0"
    "Europe/Sarajevo\0"
    "Europe/Saratov\0"
    "Europe/Simferopol\0"
    "Europe/Skopje\0"
    "Europe/Sofia\0"
    "Europe/Stockholm\0"
    "Europe/Tallinn\0"
    "Europe/Tirane\0"
    "Europe/Tiraspol\0"
    "Europe/Ulyanovsk\0"
    "Europe/Uzhgorod\0"
    "Europe/Vaduz\0"
    "Europe/Vatican\0"
    "Europe/Vienna\0"
    "Europe/Vilnius\0"
    "Europe/Volgograd\0"
    "Europe/Warsaw\0"
    "Europe/Zagreb\0"
    "Europe/Zaporozhye\0"
    "Europe/Zurich\0"
    "GB\0"
    "GB-Eire\0"
    "GMT\0"
    "GMT+0\0"
    "GMT-0\0"
    "GMT0\0"
    "Greenwich\0"
    "HST\0"
    "Hongkong\0"
    "Iceland\0"
    "Indian/Antananarivo\0"
    "Indian/Chagos\0"
    "Indian/Christmas\0"
    "Indian/Cocos\0"
    "Indian/Comoro\0"
    "Indian/Kerguelen\0"
    "Indian/Mahe\0"
    "Indian/Maldives\0"
    "Indian/Mauritius\0"
    "Indian/Mayotte\0"
    "Indian/Reunion\0"
    "Iran\0"
    "Israel\0"
    "Jamaica\0"
    "Japan\0"
    "Kwajalein\0"
    "Libya\0"
    "MET\0"
    "MST\0"
    "MST7MDT\0"
    "Mexico/BajaNorte\0"
    "Mexico/BajaSur\0"
    "Mexico/General\0"
    "NZ\0"
    "NZ-CHAT\0"
    "Navajo\0"
    "PRC\0"
    "PST8PDT\0"
    "Pacific/Apia\0"
    "Pacific/Auckland\0"
    "Pacific/Bougainville\0"
    "Pacific/Chatham\0"
    "Pacific/Chuuk\0"
    "Pacific/Easter\0"
    "Pacific/Efate\0"
    "Pacific/Enderbury\0"
    "Pacific/Fakaofo\0"
    "Pacific/Fiji\0"
    "Pacific/Funafuti\0"
    "Pacific/Galapagos\0"
    "Pacific/Gambier\0"
    "Pacific/Guadalcanal\0"
    "Pacific/Guam\0"
    "Pacific/Honolulu\0"
    "Pacific/Johnston\0"
    "Pacific/Kanton\0"
    "Pacific/Kiritimati\0"
    "Pacific/Kosrae\0"
    "Pacific/Kwajalein\0"
    "Pacific/Majuro\0"
    "Pacific/Marquesas\0"
    "Pacific/Midway\0"
    "Pacific/Nauru\0"
    "Pacific/Niue\0"
    "Pacific/Norfolk\0"
    "Pacific/Noumea\0"
    "Pacific/Pago_Pago\0"
    "Pacific/Palau\0"
    "Pacific/Pitcairn\0"
    "Pacific/Pohnpei\0"
    "Pacific/Ponape\0"
    "Pacific/Port_Moresby\0"
    "Pacific/Rarotonga\0"
    "Pacific/Saipan\0"
    "Pacific/Samoa\0"
    "Pacific/Tahiti\0"
    "Pacific/Tarawa\0"
    "Pacific/Tongatapu\0"
    "Pacific/Truk\0"
    "Pacific/Wake\0"
    "Pacific/Wallis\0"
    "Pacific/Yap\0"
    "Poland\0"
    "Portugal\0"
    "ROC\0"
    "ROK\0"
    "Singapore\0"
    "Turkey\0"
    "UCT\0"
    "US/Alaska\0"
    "US/Aleutian\0"
    "US/Arizona\0"
    "US/Central\0"
    "US/East-Indiana\0"
    "US/Eastern\0"
    "US/Hawaii\0"
    "US/Indiana-Starke\0"
    "US/Michigan\0"
    "US/Mountain\0"
    "US/Pacific\0"
    "US/Samoa\0"
    "UTC\0"
    "Universal\0"
    "W-SU\0"
    "WET\0"
    "Zulu\0";

static const uint16_t TZ_NAME_OFF[TZ_NAME_COUNT] = {
    0, 15, 28, 47, 62, 76, 90, 104, 118, 132, 146, 162,
    181, 198, 211, 229, 242, 257, 270, 291, 307, 321, 337, 353,
    369, 383, 403, 415, 430, 446, 460, 476, 489, 507, 519, 533,
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    9022, 9034, 9046, 9057, 9066, 9070, 9080, 9085, 9089,
};

static const uint8_t TZ_NAME_RULE[TZ_NAME_COUNT] = {
    67, 67, 59, 52, 59, 59, 67, 88, 67, 67, 51, 88, 51, 64, 0, 53,
    67, 67, 59, 59, 88, 0, 67, 51, 51, 85, 51, 59, 51, 51, 88, 88,
    88, 67, 88, 51, 51, 88, 51, 85, 85, 59, 67, 59, 88, 88, 67, 67,
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    87, 87, 77, 89, 87,
};
